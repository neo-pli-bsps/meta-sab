## conf/machine/alphatriplehd.conf
```bitbake
#@TYPE: Machine
#@NAME: SAB Alpha Triple HD BOX 
#@DESCRIPTION: Machine configuration for the SAB Alphatriple

IMAGEDIR ?= "sab_alpha_triple"

MKUBIFS_ARGS = "-m 2048 -e 126976 -c 8192"
UBINIZE_ARGS = "-m 2048 -p 128KiB"

MACHINE_FEATURES += " dvb-c textlcd sab-blindscan-dvbc RCA"
OPENPLI_FEATURES += " ci"
DISTRO_FEATURES_remove = "x11 wayland directfb"

CHIPSET = "bcm7241"
FORCE_REBOOT_OPTION = "reboot"

PREFERRED_VERSION_linux-sab = "4.1.24"
require conf/machine/include/sab-mipsel.inc

RCNAME = "sab1"

SOC_FAMILY = "bcm7241"

STB_PLATFORM = "g300"

RCTYPE = "503"

MTD_KERNEL = "mtd1"
MTD_ROOTFS = "mtd2"
KERNEL_FILE = "kernel.bin"
ROOTFS_FILE = "rootfs.bin"
```

## conf/machine/include/sab-essential.inc
```bitbake
MACHINE_ESSENTIAL_EXTRA_RRECOMMENDS = "\
	kernel-module-cdfs \
	\
	firmware-rtl8192eu \
	firmware-rtl8188eu \
	firmware-rtl8xxxu \
	firmware-mt7601u \
	kernel-module-r8188eu \
	kernel-module-8192eu \
	kernel-module-mt7601u \
	kernel-module-rtl8xxxu \
	kernel-module-rtl88x2bu \
	"
```
